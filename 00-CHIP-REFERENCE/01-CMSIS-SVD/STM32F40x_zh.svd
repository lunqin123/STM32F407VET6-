# STM32F40x register map
File version: 1.5
Registers are 32-bit, read-write, reset 0x0 unless marked. A register's access mark holds for its fields unless they carry their own. Offsets are from the block's base; lines under a group give offsets from that group; [hi:lo] are bit positions; {n}, {i} and the like mark numbered series; 'fields as' and 'values as' point back to an identical list; <NAME> marks a mode.

## Memory map
0x40000000 TIM2（定时器2(通用定时器)） size 0x400 — 通用定时器：计数/比较/PWM/输入捕获 | General purpose timers
0x40000400 TIM3（定时器3(通用定时器)） size 0x400 — 通用定时器：计数/比较/PWM/输入捕获 | General purpose timers
0x40000800 TIM4（定时器4(通用定时器)） size 0x400 — 通用定时器：计数/比较/PWM/输入捕获
0x40000C00 TIM5（定时器5(通用定时器)） size 0x400 — 通用定时器：计数/比较/PWM/输入捕获 | General-purpose-timers
0x40001000 TIM6（定时器6(基本定时器)） size 0x400 — 基本定时器：计数/比较/PWM/输入捕获 | Basic timers
0x40001400 TIM7（定时器7(基本定时器)） size 0x400 — 基本定时器：计数/比较/PWM/输入捕获
0x40001800 TIM12（定时器12(通用定时器)） size 0x400 — 通用定时器：计数/比较/PWM/输入捕获
0x40001C00 TIM13（定时器13(通用定时器)） size 0x400 — 通用定时器：计数/比较/PWM/输入捕获
0x40002000 TIM14（定时器14(通用定时器)） size 0x400 — 通用定时器：计数/比较/PWM/输入捕获
0x40002800 RTC（实时时钟） size 0x400 — 实时时钟：日历/闹钟/唤醒 | Real-time clock
0x40002C00 WWDG（窗口看门狗） size 0x400 — 窗口看门狗：窗口内喂狗否则复位 | Window watchdog
0x40003000 IWDG（独立看门狗） size 0x400 — 独立看门狗：超时复位（独立时钟） | Independent watchdog
0x40003400 I2S2ext（I2S2扩展） size 0x400 — I2S 全双工扩展外设（基于 SPI）
0x40003800 SPI2（串行外设接口） size 0x400 — 串行外设接口：全双工同步串行通信
0x40003C00 SPI3（串行外设接口） size 0x400 — 串行外设接口：全双工同步串行通信
0x40004000 I2S3ext（I2S3扩展） size 0x400 — I2S 全双工扩展外设（基于 SPI）
0x40004400 USART2（串口2） size 0x400 — 通用同步异步收发器：异步/同步串行通信
0x40004800 USART3（串口3） size 0x400 — 通用同步异步收发器：异步/同步串行通信
0x40004C00 UART4（串口4） size 0x400 — 通用异步收发器：异步串行通信 | Universal synchronous asynchronous receiver transmitter
0x40005000 UART5（串口5） size 0x400 — 通用异步收发器：异步串行通信
0x40005400 I2C1（集成电路总线） size 0x400 — 集成电路总线：双线制串行通信
0x40005800 I2C2（集成电路总线） size 0x400 — 集成电路总线：双线制串行通信
0x40005C00 I2C3（集成电路总线） size 0x400 — 集成电路总线：双线制串行通信 | Inter-integrated circuit
0x40006400 CAN1（控制器局域网） size 0x400 — 控制器局域网：差分串行通信 | Controller area network
0x40006800 CAN2（控制器局域网） size 0x400 — 控制器局域网：差分串行通信
0x40007000 PWR（电源控制） size 0x400 — 电源控制：稳压器/唤醒/备份域访问 | Power control
0x40007400 DAC（数模转换） size 0x400 — 数模转换器：将数字量转为模拟电压 | Digital-to-analog converter
0x40010000 TIM1（定时器1(高级定时器)） size 0x400 — 高级定时器：计数/比较/PWM/输入捕获 | Advanced-timers
0x40010400 TIM8（定时器8(高级定时器)） size 0x400 — 高级定时器：计数/比较/PWM/输入捕获
0x40011000 USART1（串口1） size 0x400 — 通用同步异步收发器：异步/同步串行通信
0x40011400 USART6（串口6） size 0x400 — 通用同步异步收发器：异步/同步串行通信 | Universal synchronous asynchronous receiver transmitter
0x40012000 ADC1（模数转换1） size 0x400 — 模数转换器：将模拟电压转为数字量 | Analog-to-digital converter
0x40012100 ADC2（模数转换2） size 0x400 — 模数转换器：将模拟电压转为数字量
0x40012200 ADC3（模数转换3） size 0x400 — 模数转换器：将模拟电压转为数字量
0x40012300 C_ADC（ADC公共） size 0x400 — ADC 公共寄存器：多 ADC 模式与采样控制 | Common ADC registers
0x40012C00 SDIO（安全数字IO） size 0x400 — 安全数字输入输出：SD 卡/MMC 接口 | Secure digital input/output interface
0x40013000 SPI1（串行外设接口） size 0x400 — 串行外设接口：全双工同步串行通信 | Serial peripheral interface
0x40013800 SYSCFG（系统配置） size 0x400 — 系统配置：存储器重映射/外部中断源选择 | System configuration controller
0x40013C00 EXTI（外部中断） size 0x400 — 外部中断/事件控制器：GPIO 等外部信号触发 | External interrupt/event controller
0x40014000 TIM9（定时器9(通用定时器)） size 0x400 — 通用定时器：计数/比较/PWM/输入捕获 | General purpose timers
0x40014400 TIM10（定时器10(通用定时器)） size 0x400 — 通用定时器：计数/比较/PWM/输入捕获 | General-purpose-timers
0x40014800 TIM11（定时器11(通用定时器)） size 0x400 — 通用定时器：计数/比较/PWM/输入捕获 | General-purpose-timers
0x40020000 GPIOA（端口A） size 0x400 — 通用输入输出端口：引脚模式/输出/复用配置与读写 | General-purpose I/Os
0x40020400 GPIOB（端口B） size 0x400 — 通用输入输出端口：引脚模式/输出/复用配置与读写 | General-purpose I/Os
0x40020800 GPIOC（端口C） size 0x400 — 通用输入输出端口：引脚模式/输出/复用配置与读写
0x40020C00 GPIOD（端口D） size 0x400 — 通用输入输出端口：引脚模式/输出/复用配置与读写
0x40021000 GPIOE（端口E） size 0x400 — 通用输入输出端口：引脚模式/输出/复用配置与读写
0x40021400 GPIOF（端口F） size 0x400 — 通用输入输出端口：引脚模式/输出/复用配置与读写
0x40021800 GPIOG（端口G） size 0x400 — 通用输入输出端口：引脚模式/输出/复用配置与读写
0x40021C00 GPIOH（端口H） size 0x400 — 通用输入输出端口：引脚模式/输出/复用配置与读写
0x40022000 GPIOI（端口I） size 0x400 — 通用输入输出端口：引脚模式/输出/复用配置与读写 | General-purpose I/Os
0x40023000 CRC（循环冗余校验） size 0x400 — CRC 计算单元：数据校验 | Cryptographic processor
0x40023800 RCC（复位与时钟控制） size 0x400 — 管理所有外设时钟使能与系统复位 | Reset and clock control
0x40023C00 FLASH（闪存） size 0x400 — 片内 Flash：编程/擦除/读保护 | FLASH
0x40026000 DMA1（直接存储器访问1） size 0x400 — DMA 控制器：外设与存储器间高速数据搬运
0x40026400 DMA2（直接存储器访问2） size 0x400 — DMA 控制器：外设与存储器间高速数据搬运 | DMA controller
0x40028000 Ethernet_MAC（以太网_MAC_媒体访问控制） size 0x400 — 以太网 MAC 媒体访问控制（best-effort） | Ethernet: media access control (MAC)
0x40028100 Ethernet_MMC（以太网_MMC_管理计数器） size 0x400 — 以太网 MMC 管理计数器（best-effort） | Ethernet: MAC management counters
0x40028700 Ethernet_PTP（以太网_PTP_精确时间协议） size 0x400 — 以太网 PTP 精确时间协议（best-effort） | Ethernet: Precision time protocol
0x40029000 Ethernet_DMA（以太网_DMA_控制器） size 0x400 — 以太网 DMA 控制器（best-effort） | Ethernet: DMA controller operation
0x40040000 OTG_HS_GLOBAL（USB_OTG_HS_全局寄存器） size 0xFFFC0400 — USB OTG HS 全局寄存器（best-effort） | USB on the go high speed
0x40040400 OTG_HS_HOST（USB_OTG_HS_主机寄存器） size 0x400 — USB OTG HS 主机寄存器（best-effort） | USB on the go high speed
0x40040800 OTG_HS_DEVICE（USB_OTG_HS_设备寄存器） size 0x400 — USB OTG HS 设备寄存器（best-effort） | USB on the go high speed
0x40040E00 OTG_HS_PWRCLK（USB_OTG_HS_电源时钟寄存器） size 0x3F200 — USB OTG HS 电源时钟寄存器（best-effort） | USB on the go high speed
0x50000000 OTG_FS_GLOBAL（USB_OTG_FS_全局寄存器） size 0x400 — USB OTG FS 全局寄存器（best-effort） | USB on the go full speed
0x50000400 OTG_FS_HOST（USB_OTG_FS_主机寄存器） size 0x400 — USB OTG FS 主机寄存器（best-effort） | USB on the go full speed
0x50000800 OTG_FS_DEVICE（USB_OTG_FS_设备寄存器） size 0x400 — USB OTG FS 设备寄存器（best-effort） | USB on the go full speed
0x50000E00 OTG_FS_PWRCLK（USB_OTG_FS_电源时钟寄存器） size 0x400 — USB OTG FS 电源时钟寄存器（best-effort） | USB on the go full speed
0x50050000 DCMI（数字摄像头接口） size 0x400 — 数字摄像头接口：并行图像采集 | Digital camera interface
0x50060800 RNG（随机数发生器） size 0x400 — 真随机数发生器 | Random number generator
0xA0000000 FSMC（静态存储器控制） size 0x400 — FSMC：NOR/PSRAM/NAND 外部存储器控制 | Flexible static memory controller
0xE000E000 NVIC（中断控制器） size 0x1001 — 嵌套向量中断控制器：中断使能与优先级 | Nested Vectored Interrupt Controller
0xE0042000 DBG（调试支持） size 0x400 — 调试支持单元：调试时外设行为控制 | Debug support

## Interrupts
0 WWDG_IRQ (WWDG（窗口看门狗）) — Window Watchdog interrupt
1 PVD_IRQ (PWR（电源控制）) — PVD through EXTI line detection interrupt
2 TAMP_STAMP_IRQ (EXTI（外部中断）) — Tamper and TimeStamp interrupts through the EXTI line
3 RTC_WKUP_IRQ (RTC（实时时钟）) — RTC Wakeup interrupt through the EXTI line
5 RCC_IRQ (RCC（复位与时钟控制）) — RCC global interrupt
6 EXTI0_IRQ (EXTI（外部中断）) — EXTI Line0 interrupt
7 EXTI1_IRQ (EXTI（外部中断）) — EXTI Line1 interrupt
8 EXTI2_IRQ (EXTI（外部中断）) — EXTI Line2 interrupt
9 EXTI3_IRQ (EXTI（外部中断）) — EXTI Line3 interrupt
10 EXTI4_IRQ (EXTI（外部中断）) — EXTI Line4 interrupt
11 DMA1_Stream0_IRQ (DMA1（直接存储器访问1）) — DMA1 Stream0 global interrupt
12 DMA1_Stream1_IRQ (DMA1（直接存储器访问1）) — DMA1 Stream1 global interrupt
13 DMA1_Stream2_IRQ (DMA1（直接存储器访问1）) — DMA1 Stream2 global interrupt
14 DMA1_Stream3_IRQ (DMA1（直接存储器访问1）) — DMA1 Stream3 global interrupt
15 DMA1_Stream4_IRQ (DMA1（直接存储器访问1）) — DMA1 Stream4 global interrupt
16 DMA1_Stream5_IRQ (DMA1（直接存储器访问1）) — DMA1 Stream5 global interrupt
17 DMA1_Stream6_IRQ (DMA1（直接存储器访问1）) — DMA1 Stream6 global interrupt
18 ADC_IRQ (ADC{n}（模数转换{n}） (n=1..3)) — ADC1 global interrupt
19 CAN1_TX_IRQ (CAN1（控制器局域网）) — CAN1 TX interrupts
20 CAN1_RX0_IRQ (CAN1（控制器局域网）) — CAN1 RX0 interrupts
21 CAN1_RX1_IRQ (CAN1（控制器局域网）) — CAN1 RX1 interrupts
22 CAN1_SCE_IRQ (CAN1（控制器局域网）) — CAN1 SCE interrupt
23 EXTI9_5_IRQ (EXTI（外部中断）) — EXTI Line[9:5] interrupts
24 TIM1_BRK_TIM9_IRQ (TIM1（定时器1(高级定时器)）, TIM9（定时器9(通用定时器)）) — TIM1 Break interrupt and TIM9 global interrupt
25 TIM1_UP_TIM10_IRQ (TIM1（定时器1(高级定时器)）, TIM10（定时器10(通用定时器)）) — TIM1 Update interrupt and TIM10 global interrupt
26 TIM1_TRG_COM_TIM11_IRQ (TIM1（定时器1(高级定时器)）, TIM11（定时器11(通用定时器)）) — TIM1 Trigger and Commutation interrupts and TIM11 global interrupt
27 TIM1_CC_IRQ (TIM1（定时器1(高级定时器)）) — TIM1 Capture Compare interrupt
28 TIM2_IRQ (TIM2（定时器2(通用定时器)）) — TIM2 global interrupt
29 TIM3_IRQ (TIM3（定时器3(通用定时器)）) — TIM3 global interrupt
30 TIM4_IRQ (TIM4（定时器4(通用定时器)）) — TIM4 global interrupt
31 I2C1_EV_IRQ (I2C1（集成电路总线）) — I2C1 event interrupt
32 I2C1_ER_IRQ (I2C1（集成电路总线）) — I2C1 error interrupt
33 I2C2_EV_IRQ (I2C2（集成电路总线）) — I2C2 event interrupt
34 I2C2_ER_IRQ (I2C2（集成电路总线）) — I2C2 error interrupt
35 SPI1_IRQ (SPI1（串行外设接口）) — SPI1 global interrupt
36 SPI2_IRQ (SPI2（串行外设接口）) — SPI2 global interrupt
37 USART1_IRQ (USART1（串口1）) — USART1 global interrupt
38 USART2_IRQ (USART2（串口2）) — USART2 global interrupt
39 USART3_IRQ (USART3（串口3）) — USART3 global interrupt
40 EXTI15_10_IRQ (EXTI（外部中断）) — EXTI Line[15:10] interrupts
41 RTC_Alarm_IRQ (RTC（实时时钟）) — RTC Alarms (A and B) through EXTI line interrupt
42 OTG_FS_WKUP_IRQ (OTG_FS_GLOBAL（USB_OTG_FS_全局寄存器）) — USB On-The-Go FS Wakeup through EXTI line interrupt
43 TIM8_BRK_TIM12_IRQ (TIM8（定时器8(高级定时器)）, TIM12（定时器12(通用定时器)）) — TIM8 Break interrupt and TIM12 global interrupt
44 TIM8_UP_TIM13_IRQ (TIM8（定时器8(高级定时器)）, TIM13（定时器13(通用定时器)）) — TIM8 Update interrupt and TIM13 global interrupt
45 TIM8_TRG_COM_TIM14_IRQ (TIM8（定时器8(高级定时器)）, TIM14（定时器14(通用定时器)）) — TIM8 Trigger and Commutation interrupts and TIM14 global interrupt
46 TIM8_CC_IRQ (TIM8（定时器8(高级定时器)）) — TIM8 Capture Compare interrupt
47 DMA1_Stream7_IRQ (DMA1（直接存储器访问1）) — DMA1 Stream7 global interrupt
48 FSMC_IRQ (FSMC（静态存储器控制）) — FSMC global interrupt
49 SDIO_IRQ (SDIO（安全数字IO）) — SDIO global interrupt
50 TIM5_IRQ (TIM5（定时器5(通用定时器)）) — TIM5 global interrupt
51 SPI3_IRQ (SPI3（串行外设接口）) — SPI3 global interrupt
52 UART4_IRQ (UART4（串口4）) — UART4 global interrupt
53 UART5_IRQ (UART5（串口5）) — UART5 global interrupt
54 TIM6_DAC_IRQ (DAC（数模转换）, TIM6（定时器6(基本定时器)）) — TIM6 global interrupt, DAC1 and DAC2 underrun error interrupt
55 TIM7_IRQ (TIM7（定时器7(基本定时器)）) — TIM7 global interrupt
56 DMA2_Stream0_IRQ (DMA2（直接存储器访问2）) — DMA2 Stream0 global interrupt
57 DMA2_Stream1_IRQ (DMA2（直接存储器访问2）) — DMA2 Stream1 global interrupt
58 DMA2_Stream2_IRQ (DMA2（直接存储器访问2）) — DMA2 Stream2 global interrupt
59 DMA2_Stream3_IRQ (DMA2（直接存储器访问2）) — DMA2 Stream3 global interrupt
60 DMA2_Stream4_IRQ (DMA2（直接存储器访问2）) — DMA2 Stream4 global interrupt
61 ETH_IRQ (Ethernet_MAC（以太网_MAC_媒体访问控制）) — Ethernet global interrupt
62 ETH_WKUP_IRQ (Ethernet_MAC（以太网_MAC_媒体访问控制）) — Ethernet Wakeup through EXTI line interrupt
63 CAN2_TX_IRQ (CAN2（控制器局域网）) — CAN2 TX interrupts
64 CAN2_RX0_IRQ (CAN2（控制器局域网）) — CAN2 RX0 interrupts
65 CAN2_RX1_IRQ (CAN2（控制器局域网）) — CAN2 RX1 interrupts
66 CAN2_SCE_IRQ (CAN2（控制器局域网）) — CAN2 SCE interrupt
67 OTG_FS_IRQ (OTG_FS_GLOBAL（USB_OTG_FS_全局寄存器）) — USB On The Go FS global interrupt
68 DMA2_Stream5_IRQ (DMA2（直接存储器访问2）) — DMA2 Stream5 global interrupt
69 DMA2_Stream6_IRQ (DMA2（直接存储器访问2）) — DMA2 Stream6 global interrupt
70 DMA2_Stream7_IRQ (DMA2（直接存储器访问2）) — DMA2 Stream7 global interrupt
71 USART6_IRQ (USART6（串口6）) — USART6 global interrupt
72 I2C3_EV_IRQ (I2C3（集成电路总线）) — I2C3 event interrupt
73 I2C3_ER_IRQ (I2C3（集成电路总线）) — I2C3 error interrupt
74 OTG_HS_EP1_OUT_IRQ (OTG_HS_GLOBAL（USB_OTG_HS_全局寄存器）) — USB On The Go HS End Point 1 Out global interrupt
75 OTG_HS_EP1_IN_IRQ (OTG_HS_GLOBAL（USB_OTG_HS_全局寄存器）) — USB On The Go HS End Point 1 In global interrupt
76 OTG_HS_WKUP_IRQ (OTG_HS_GLOBAL（USB_OTG_HS_全局寄存器）) — USB On The Go HS Wakeup through EXTI interrupt
77 OTG_HS_IRQ (OTG_HS_GLOBAL（USB_OTG_HS_全局寄存器）) — USB On The Go HS global interrupt
78 DCMI_IRQ (DCMI（数字摄像头接口）) — DCMI global interrupt
